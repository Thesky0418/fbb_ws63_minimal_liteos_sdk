## src/application/Kconfig
```kconfig
#===============================================================================
# @brief    Kconfig file.
# Copyright (c) HiSilicon (Shanghai) Technologies Co., Ltd. 2023-2023. All rights reserved.
#===============================================================================

config SAMPLE_ENABLE
    bool
    default n
    help
        Samples and demo applications are removed from this SDK baseline.
```
